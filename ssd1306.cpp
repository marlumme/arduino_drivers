/*
        (c) Martti@Lumme.org 2016
        Free to copy, use and modify when this header remains in the code
*/
#include "ssd1306.h"

static const char font8x5[][6] PROGMEM = {  
 
{0x00,0x00,0x00,0x00,0x00,0x00},
{0x00,0x00,0x5F,0x00,0x00,0x00},
{0x00,0x00,0x07,0x00,0x07,0x00},
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{0x00,0x02,0x05,0x05,0x02,0x00} 
};




SSD1306::SSD1306(uint8_t address, uint8_t offset,uint8_t sda, uint8_t scl)
{
  _sda = sda;
  _scl = scl; 
   _address = address;
  _offset = offset; 
  _y = 0;
  _c = _x = 1;
}


void SSD1306::begin(void) {
  // set up i2c

#if ARDUINO 
  Wire.begin();
#else
  Wire.begin(_sda, _scl);
#endif
  init();
  visible(0);
  clear();
  visible(1);
}
void SSD1306::visible(byte onoff)
{
  sendcommand(onoff?0xAF:0xAE);
}

void SSD1306::sendcommand(uint8_t com)
{
  Wire.wr(_address,0x80,com);
  /*
  Wire.beginTransmission(_address);     //begin transmitting
  Wire.write(0x80);                          //command mode
  Wire.write(com);
  Wire.endTransmission();                    // stop transmitting
  */
}

void SSD1306::setRY(uint8_t row,uint8_t col)
{
  sendcommand(0xb0+row);                //set page address
  sendcommand(_offset+(8*col&0x0f));       //set low col address
  sendcommand(0x10+((8*col>>4)&0x0f));  //set high col address
}




void SSD1306::clear(void)
{
  unsigned char i,k;
  for(k=0;k<8;k++)
  {  
    setRY(k,0);    
    {
      for(i=0;i<130;i++) {
        wrByte(0);         //clear all COL
      }
    }
  }
} 
void SSD1306::wrByte(uint8_t data)
{
  Wire.wr(_address,0x40,data);
  /*
  Wire.beginTransmission(_address); // begin transmitting
  Wire.write(0x40);//data mode
    Wire.write(data);  
  Wire.endTransmission();    // stop transmitting
  */
}

byte SSD1306::rdByte()
{

 byte out;
 /*
  Wire.beginTransmission(_address); // begin transmitting
  Wire.write(0x40);//data mode
  Wire.endTransmission();    // stop transmitting
  Wire.requestFrom(_address,1,true);  // 
  out=Wire.read();
 */
  Wire.rd(_address,0x40,&out,1);           
  return out;
}
void SSD1306::setPixel(int x,int y,int z)
{
  byte w;
/*  Serial.print("x:");Serial.print(x);
  Serial.print(" y:");Serial.print(y);
  Serial.print(" z:");Serial.println(z);
  
  */
  if(x<0 || x>127 || y<0 || y>63) return;
  
  sendcommand(0xb0+(y>>3));                //set page address
  sendcommand(_offset+(x&0x0f));       //set low col address
  sendcommand(0x10+((x>>4)&0x0f));  //set high col address
  w = rdByte();
  w = rdByte();
  
  switch(z){
    case 0: w &= ~(1<<(y&7));break;
    case 1: w |= (1<<(y&7));break;
    case 2: w ^= (1<<(y&7));break;
  }
 // sendcommand(0xb0+(y>>3));                //set page address
  sendcommand(_offset+(x&0x0f));       //set low col address
  sendcommand(0x10+((x>>4)&0x0f));  //set high col address
  wrByte(w); 
}

void SSD1306::moveto(int x,int y)
{
  _x = x;
  _y = y;
}

void SSD1306::lineto(int x,int y)
{
int dx,dy,dd,xx,yy;
  dx = x - _x;
  dy = y - _y;
  
  if(dy<0){
    yy = -1;
    dy =-dy;
  } else yy=1;
  if(dx<0){
    xx = -1;
    dx = -dx;
  } else xx=1;
  if(dy==0){
     for(;x!=_x;_x+=xx) setPixel(_x,_y,_c);
     return;
  }
  if(dx==0){
     for(;y!=_y;_y+=yy) setPixel(_x,_y,_c);
     return;
  }

  dd = dx -dy;
  
  for(;;){ 
//  Serial.printf("# %d %d %d\n",dd,dy,dx);
      setPixel(_x,_y,_c);
    if(_x == x && _y ==y) break;
    if(dd>=0){
     _x +=xx;
     dd -= dy;
    } else{
     _y +=yy;
     dd += dx;
    } 
  }
}



void SSD1306::circle(int r)
{
    int x = r;
    int y = 0;
    int i;
    int err = 0;
    char e;
    for(i=0;i<10000;i++) {
        setPixel(_x + x, _y + y,_c);
        i = x>=0?0:1;
        i +=y>=0?0:2;

                e = err>0;
                if(x>=0){
                        err += (y<0)
                        ?(e?- ++x:- ++y)
                        :(e?- --x: ++y);
                        if(y==0) break;
                        if(x<0 ) err=0;

                }else{
                        err += (y<0)
                        ?(e? ++x:- --y)
                        :(e? --x:  --y);
                        if(y==0) err=0;
                }

 
    }

}

void SSD1306::wrChar(unsigned char data)
{
  int x,y;
  byte z;
  
  for(int x=0;x<6;x++) {         
    z = pgm_read_byte(font8x5[data-0x20]+x);
    for(y=0;y<8;y++){
      setPixel(x  + _x, y + _y, (z>>y)&1);
    }
  }
  _x += 6;
  if(_x>=120) {
    _y += 8;
    _x = 1;
  }
}
size_t SSD1306::write(uint8_t data)
{
 wrChar(data);
 return 1; 
}
void SSD1306::text(unsigned char *data)
{
  while(*data) wrChar(*data++);
}
void SSD1306::pen(int color)
{
  _c = color;
}
void SSD1306::init(void)
{
  sendcommand(0xae);    //display off
  sendcommand(0xa6);            //Set Normal Display (default)
    // Adafruit Init sequence for 128x64 OLED module
    sendcommand(0xAE);             //DISPLAYOFF
    sendcommand(0xD5);            //SETDISPLAYCLOCKDIV
    sendcommand(0x80);            // the suggested ratio 0x80
    sendcommand(0xA8);            //SSD1306_SETMULTIPLEX
    sendcommand(0x3F);
    sendcommand(0xD3);            //SETDISPLAYOFFSET
    sendcommand(0x0);             //no offset
    sendcommand(0x40 | 0x0);      //SETSTARTLINE
    sendcommand(0x8D);            //CHARGEPUMP
    sendcommand(0x14);
    sendcommand(0x20);             //MEMORYMODE
    sendcommand(0x00);             //0x0 act like ks0108
    
    //sendcommand(0xA0 | 0x1);      //SEGREMAP   //Rotate screen 180 deg
    sendcommand(0xA0);
    
    //sendcommand(0xC8);            //COMSCANDEC  Rotate screen 180 Deg
    sendcommand(0xC0);
    
    sendcommand(0xDA);            //0xDA
    sendcommand(0x12);           //COMSCANDEC
    sendcommand(0x81);           //SETCONTRAS
    sendcommand(0xCF);           //
    sendcommand(0xd9);          //SETPRECHARGE 
    sendcommand(0xF1); 
    sendcommand(0xDB);        //SETVCOMDETECT                
    sendcommand(0x40);
    sendcommand(0xA4);        //DISPLAYALLON_RESUME        
    sendcommand(0xA6);        //NORMALDISPLAY             

  clear();
  sendcommand(0x2e);            // stop scroll
  //----------------------------REVERSE comments----------------------------//
    sendcommand(0xa0);    //seg re-map 0->127(default)
    sendcommand(0xa1);    //seg re-map 127->0
    sendcommand(0xc8);
    delay(1000);
  //----------------------------REVERSE comments----------------------------//
  // sendcommand(0xa7);  //Set Inverse Display  
  // sendcommand(0xae);   //display off
  sendcommand(0x20);            //Set Memory Addressing Mode
  sendcommand(0x00);            //Set Memory Addressing Mode ab Horizontal addressing mode
  //  sendcommand(0x02);         // Set Memory Addressing Mode ab Page addressing mode(RESET)  
}



